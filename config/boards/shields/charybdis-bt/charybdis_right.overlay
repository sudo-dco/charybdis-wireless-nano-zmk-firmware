#include "charybdis.dtsi"

// The matrix transform is 6 columns over because the left half is 6 columns wide.
&default_transform {
	col-offset = <5>;
};

&kscan0 {
	col-gpios
		= <&pro_micro 19 (GPIO_ACTIVE_HIGH)>
		, <&pro_micro 20 (GPIO_ACTIVE_HIGH)>
		, <&pro_micro 10 (GPIO_ACTIVE_HIGH)>
		, <&pro_micro 6 (GPIO_ACTIVE_HIGH)>
		, <&pro_micro 7 (GPIO_ACTIVE_HIGH)>
		;

};

