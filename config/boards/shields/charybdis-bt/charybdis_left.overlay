#include "charybdis.dtsi"
#include "charybdis_pmw3610.dtsi"

&kscan0 {
	col-gpios
		= <&pro_micro 19 (GPIO_ACTIVE_HIGH)>
		, <&pro_micro 20 (GPIO_ACTIVE_HIGH)>
		, <&pro_micro 10 (GPIO_ACTIVE_HIGH)>
		, <&pro_micro 6 (GPIO_ACTIVE_HIGH)>
		;
};

// https://github.com/badjeff/zmk-pmw3610-driver
/ {
  trackball_listener {
    compatible = "zmk,input-listener";
    device = <&trackball>;
  };
};